## main/Kconfig.projbuild
```kconfig
# Configuration Kconfig pour SecureIoT-VIF

menu "SecureIoT-VIF Configuration"
    
    menu "Security Configuration"
        config SECURE_IOT_SECURITY_LEVEL
            int "Security Level (1=Low, 2=Medium, 3=High, 4=Critical)"
            default 3
            range 1 4
            help
                Set the security level for the framework.
                Higher levels provide more security but may impact performance.
        
        config SECURE_IOT_ENABLE_SECURE_BOOT
            bool "Enable Secure Boot"
            default y
            help
                Enable secure boot verification using ESP32 integrated crypto.
        
        config SECURE_IOT_ENABLE_FLASH_ENCRYPTION
            bool "Enable Flash Encryption"
            default y
            help
                Enable flash encryption for firmware protection.
        
        config SECURE_IOT_MAX_INTEGRITY_FAILURES
            int "Maximum Integrity Check Failures"
            default 3
            range 1 10
            help
                Maximum number of consecutive integrity check failures before emergency shutdown.
    endmenu

    menu "Hardware Configuration"
        config SECURE_IOT_DHT22_GPIO
            int "DHT22 Data GPIO Pin"
            default 4
            range 0 39
            help
                GPIO pin number for DHT22 sensor data line.
        
        config SECURE_IOT_DHT22_POWER_GPIO
            int "DHT22 Power GPIO Pin"  
            default 5
            range 0 39
            help
                GPIO pin number for DHT22 sensor power control.
        
        config SECURE_IOT_STATUS_LED_GPIO
            int "Status LED GPIO Pin"
            default 2
            range 0 39
            help
                GPIO pin number for status indication LED.
    endmenu

    menu "Monitoring Configuration"
        config SECURE_IOT_INTEGRITY_CHECK_INTERVAL
            int "Integrity Check Interval (seconds)"
            default 60
            range 10 3600
            help
                Interval between periodic firmware integrity checks.
        
        config SECURE_IOT_ATTESTATION_INTERVAL
            int "Attestation Interval (seconds)"
            default 30
            range 10 600
            help
                Interval between continuous attestation checks.
        
        config SECURE_IOT_SENSOR_READ_INTERVAL
            int "Sensor Read Interval (milliseconds)"
            default 2000
            range 500 10000
            help
                Interval between sensor readings.
        
        config SECURE_IOT_ANOMALY_DETECTION
            bool "Enable Anomaly Detection"
            default y
            help
                Enable behavioral anomaly detection on sensor data.
    endmenu

    menu "Network Configuration"
        config SECURE_IOT_WIFI_SSID
            string "WiFi SSID"
            default "SecureIoT-Network"
            help
                WiFi network name for secure communications.
        
        config SECURE_IOT_WIFI_PASSWORD
            string "WiFi Password"
            default "SecureIoT123!"
            help
                WiFi network password.
        
        config SECURE_IOT_ENABLE_REMOTE_ATTESTATION
            bool "Enable Remote Attestation"
            default y
            help
                Enable remote attestation capabilities via network.
        
        config SECURE_IOT_MQTT_BROKER
            string "MQTT Broker Address"
            default "secure-iot-broker.local"
            depends on SECURE_IOT_ENABLE_REMOTE_ATTESTATION
            help
                MQTT broker address for remote attestation.
    endmenu

    menu "Power Management"
        config SECURE_IOT_ENABLE_POWER_SAVE
            bool "Enable Power Save Mode"
            default n
            help
                Enable power saving features for battery-powered devices.
        
        config SECURE_IOT_SLEEP_DURATION
            int "Sleep Duration (seconds)"
            default 60
            range 10 300
            depends on SECURE_IOT_ENABLE_POWER_SAVE
            help
                Duration of sleep periods in power save mode.
    endmenu

    menu "Debug Configuration"
        config SECURE_IOT_DEBUG_LEVEL
            int "Debug Level (0=None, 1=Error, 2=Warning, 3=Info, 4=Debug, 5=Verbose)"
            default 3
            range 0 5
            help
                Set the debug output level for the framework.
        
        config SECURE_IOT_ENABLE_SECURITY_LOGGING
            bool "Enable Security Event Logging"
            default y
            help
                Enable logging of security events to NVS storage.
        
        config SECURE_IOT_ENABLE_PERFORMANCE_MONITORING
            bool "Enable Performance Monitoring"
            default n
            help
                Enable performance monitoring and statistics collection.
    endmenu

endmenu
```
